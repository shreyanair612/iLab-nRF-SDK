## 04_wakeWord/build/Kconfig/soc/Kconfig.tmp
```kconfig
# Load Zephyr SoC Kconfig descriptions.
osource "/Users/shreybae/Documents/iLAB/nrfedgeAI_workspace/zephyr/soc/xlnx/zynqmp/Kconfig"
osource "/Users/shreybae/Documents/iLAB/nrfedgeAI_workspace/zephyr/soc/xlnx/zynq7000/Kconfig"
osource "/Users/shreybae/Documents/iLAB/nrfedgeAI_workspace/zephyr/soc/xlnx/versalnet/Kconfig"
osource "/Users/shreybae/Documents/iLAB/nrfedgeAI_workspace/zephyr/soc/xlnx/versal2/Kconfig"
osource "/Users/shreybae/Documents/iLAB/nrfedgeAI_workspace/zephyr/soc/xlnx/versal/Kconfig"
osource "/Users/shreybae/Documents/iLAB/nrfedgeAI_workspace/zephyr/soc/xen/Kconfig"
osource "/Users/shreybae/Documents/iLAB/nrfedgeAI_workspace/zephyr/soc/wch/ch32v/Kconfig"
osource "/Users/shreybae/Documents/iLAB/nrfedgeAI_workspace/zephyr/soc/ti/simplelink/Kconfig"
osource "/Users/shreybae/Documents/iLAB/nrfedgeAI_workspace/zephyr/soc/ti/mspm0/Kconfig"
osource "/Users/shreybae/Documents/iLAB/nrfedgeAI_workspace/zephyr/soc/ti/lm3s6965/Kconfig"
osource "/Users/shreybae/Documents/iLAB/nrfedgeAI_workspace/zephyr/soc/ti/k3/Kconfig"
osource "/Users/shreybae/Documents/iLAB/nrfedgeAI_workspace/zephyr/soc/telink/tlsr/Kconfig"
osource "/Users/shreybae/Documents/iLAB/nrfedgeAI_workspace/zephyr/soc/starfive/jh71xx/Kconfig"
osource "/Users/shreybae/Documents/iLAB/nrfedgeAI_workspace/zephyr/soc/st/stm32/Kconfig"
osource "/Users/shreybae/Documents/iLAB/nrfedgeAI_workspace/zephyr/soc/snps/qemu_arc/Kconfig"
osource "/Users/shreybae/Documents/iLAB/nrfedgeAI_workspace/zephyr/soc/snps/nsim/arc_v/Kconfig"
osource "/Users/shreybae/Documents/iLAB/nrfedgeAI_workspace/zephyr/soc/snps/nsim/arc_classic/Kconfig"
osource "/Users/shreybae/Documents/iLAB/nrfedgeAI_workspace/zephyr/soc/snps/hsdk4xd/Kconfig"
osource "/Users/shreybae/Documents/iLAB/nrfedgeAI_workspace/zephyr/soc/snps/hsdk/Kconfig"
osource "/Users/shreybae/Documents/iLAB/nrfedgeAI_workspace/zephyr/soc/snps/emsk/Kconfig"
osource "/Users/shreybae/Documents/iLAB/nrfedgeAI_workspace/zephyr/soc/snps/emsdp/Kconfig"
osource "/Users/shreybae/Documents/iLAB/nrfedgeAI_workspace/zephyr/soc/snps/arc_iot/Kconfig"
osource "/Users/shreybae/Documents/iLAB/nrfedgeAI_workspace/zephyr/soc/silabs/Kconfig"
osource "/Users/shreybae/Documents/iLAB/nrfedgeAI_workspace/zephyr/soc/sifli/sf32/Kconfig"
osource "/Users/shreybae/Documents/iLAB/nrfedgeAI_workspace/zephyr/soc/sifive/sifive_freedom/Kconfig"
osource "/Users/shreybae/Documents/iLAB/nrfedgeAI_workspace/zephyr/soc/sensry/Kconfig"
osource "/Users/shreybae/Documents/iLAB/nrfedgeAI_workspace/zephyr/soc/rockchip/Kconfig"
osource "/Users/shreybae/Documents/iLAB/nrfedgeAI_workspace/zephyr/soc/renode/riscv_virtual/Kconfig"
osource "/Users/shreybae/Documents/iLAB/nrfedgeAI_workspace/zephyr/soc/renode/cortex_r8_virtual/Kconfig"
osource "/Users/shreybae/Documents/iLAB/nrfedgeAI_workspace/zephyr/soc/renesas/smartbond/Kconfig"
osource "/Users/shreybae/Documents/iLAB/nrfedgeAI_workspace/zephyr/soc/renesas/rz/Kconfig"
osource "/Users/shreybae/Documents/iLAB/nrfedgeAI_workspace/zephyr/soc/renesas/rx/Kconfig"
osource "/Users/shreybae/Documents/iLAB/nrfedgeAI_workspace/zephyr/soc/renesas/rcar/Kconfig"
osource "/Users/shreybae/Documents/iLAB/nrfedgeAI_workspace/zephyr/soc/renesas/ra/Kconfig"
osource "/Users/shreybae/Documents/iLAB/nrfedgeAI_workspace/zephyr/soc/realtek/ec/Kconfig"
osource "/Users/shreybae/Documents/iLAB/nrfedgeAI_workspace/zephyr/soc/realtek/ameba/Kconfig"
osource "/Users/shreybae/Documents/iLAB/nrfedgeAI_workspace/zephyr/soc/raspberrypi/rpi_pico/Kconfig"
osource "/Users/shreybae/Documents/iLAB/nrfedgeAI_workspace/zephyr/soc/quicklogic/eos_s3/Kconfig"
osource "/Users/shreybae/Documents/iLAB/nrfedgeAI_workspace/zephyr/soc/qemu/virt_riscv/Kconfig"
osource "/Users/shreybae/Documents/iLAB/nrfedgeAI_workspace/zephyr/soc/qemu/malta/Kconfig"
osource "/Users/shreybae/Documents/iLAB/nrfedgeAI_workspace/zephyr/soc/openisa/rv32m1/Kconfig"
osource "/Users/shreybae/Documents/iLAB/nrfedgeAI_workspace/zephyr/soc/openhwgroup/cva6/Kconfig"
osource "/Users/shreybae/Documents/iLAB/nrfedgeAI_workspace/zephyr/soc/oct/osd32mp15x/Kconfig"
osource "/Users/shreybae/Documents/iLAB/nrfedgeAI_workspace/zephyr/soc/nxp/s32/Kconfig"
osource "/Users/shreybae/Documents/iLAB/nrfedgeAI_workspace/zephyr/soc/nxp/rw/Kconfig"
osource "/Users/shreybae/Documents/iLAB/nrfedgeAI_workspace/zephyr/soc/nxp/mcx/Kconfig"
osource "/Users/shreybae/Documents/iLAB/nrfedgeAI_workspace/zephyr/soc/nxp/lpc/Kconfig"
osource "/Users/shreybae/Documents/iLAB/nrfedgeAI_workspace/zephyr/soc/nxp/layerscape/Kconfig"
osource "/Users/shreybae/Documents/iLAB/nrfedgeAI_workspace/zephyr/soc/nxp/kinetis/Kconfig"
osource "/Users/shreybae/Documents/iLAB/nrfedgeAI_workspace/zephyr/soc/nxp/imxrt/Kconfig"
osource "/Users/shreybae/Documents/iLAB/nrfedgeAI_workspace/zephyr/soc/nxp/imx/Kconfig"
osource "/Users/shreybae/Documents/iLAB/nrfedgeAI_workspace/zephyr/soc/nuvoton/numicro/Kconfig"
osource "/Users/shreybae/Documents/iLAB/nrfedgeAI_workspace/zephyr/soc/nuvoton/numaker/Kconfig"
osource "/Users/shreybae/Documents/iLAB/nrfedgeAI_workspace/zephyr/soc/nuvoton/npcx/Kconfig"
osource "/Users/shreybae/Documents/iLAB/nrfedgeAI_workspace/zephyr/soc/nuvoton/npcm/Kconfig"
osource "/Users/shreybae/Documents/iLAB/nrfedgeAI_workspace/zephyr/soc/nordic/Kconfig"
osource "/Users/shreybae/Documents/iLAB/nrfedgeAI_workspace/zephyr/soc/neorv32/Kconfig"
osource "/Users/shreybae/Documents/iLAB/nrfedgeAI_workspace/zephyr/soc/native/inf_clock/Kconfig"
osource "/Users/shreybae/Documents/iLAB/nrfedgeAI_workspace/zephyr/soc/microchip/sam/sama7/Kconfig"
osource "/Users/shreybae/Documents/iLAB/nrfedgeAI_workspace/zephyr/soc/microchip/sam/sam_d5x_e5x/Kconfig"
osource "/Users/shreybae/Documents/iLAB/nrfedgeAI_workspace/zephyr/soc/microchip/pic64/Kconfig"
osource "/Users/shreybae/Documents/iLAB/nrfedgeAI_workspace/zephyr/soc/microchip/pic32c/pic32cz_ca/Kconfig"
osource "/Users/shreybae/Documents/iLAB/nrfedgeAI_workspace/zephyr/soc/microchip/pic32c/pic32cx_sg/Kconfig"
osource "/Users/shreybae/Documents/iLAB/nrfedgeAI_workspace/zephyr/soc/microchip/pic32c/pic32cm_jh/Kconfig"
osource "/Users/shreybae/Documents/iLAB/nrfedgeAI_workspace/zephyr/soc/microchip/miv/Kconfig"
osource "/Users/shreybae/Documents/iLAB/nrfedgeAI_workspace/zephyr/soc/microchip/mec/Kconfig"
osource "/Users/shreybae/Documents/iLAB/nrfedgeAI_workspace/zephyr/soc/mediatek/mt8xxx/Kconfig"
osource "/Users/shreybae/Documents/iLAB/nrfedgeAI_workspace/zephyr/soc/lowrisc/opentitan/Kconfig"
osource "/Users/shreybae/Documents/iLAB/nrfedgeAI_workspace/zephyr/soc/litex/litex_vexriscv/Kconfig"
osource "/Users/shreybae/Documents/iLAB/nrfedgeAI_workspace/zephyr/soc/ite/ec/Kconfig"
osource "/Users/shreybae/Documents/iLAB/nrfedgeAI_workspace/zephyr/soc/intel/wildcat_lake/Kconfig"
osource "/Users/shreybae/Documents/iLAB/nrfedgeAI_workspace/zephyr/soc/intel/raptor_lake/Kconfig"
osource "/Users/shreybae/Documents/iLAB/nrfedgeAI_workspace/zephyr/soc/intel/panther_lake/Kconfig"
osource "/Users/shreybae/Documents/iLAB/nrfedgeAI_workspace/zephyr/soc/intel/lakemont/Kconfig"
osource "/Users/shreybae/Documents/iLAB/nrfedgeAI_workspace/zephyr/soc/intel/intel_socfpga_std/Kconfig"
osource "/Users/shreybae/Documents/iLAB/nrfedgeAI_workspace/zephyr/soc/intel/intel_socfpga/Kconfig"
osource "/Users/shreybae/Documents/iLAB/nrfedgeAI_workspace/zephyr/soc/intel/intel_niosv/Kconfig"
osource "/Users/shreybae/Documents/iLAB/nrfedgeAI_workspace/zephyr/soc/intel/intel_ish/Kconfig"
osource "/Users/shreybae/Documents/iLAB/nrfedgeAI_workspace/zephyr/soc/intel/intel_adsp/Kconfig"
osource "/Users/shreybae/Documents/iLAB/nrfedgeAI_workspace/zephyr/soc/intel/elkhart_lake/Kconfig"
osource "/Users/shreybae/Documents/iLAB/nrfedgeAI_workspace/zephyr/soc/intel/atom/Kconfig"
osource "/Users/shreybae/Documents/iLAB/nrfedgeAI_workspace/zephyr/soc/intel/apollo_lake/Kconfig"
osource "/Users/shreybae/Documents/iLAB/nrfedgeAI_workspace/zephyr/soc/intel/alder_lake/Kconfig"
osource "/Users/shreybae/Documents/iLAB/nrfedgeAI_workspace/zephyr/soc/infineon/psoc4/Kconfig"
osource "/Users/shreybae/Documents/iLAB/nrfedgeAI_workspace/zephyr/soc/infineon/edge/Kconfig"
osource "/Users/shreybae/Documents/iLAB/nrfedgeAI_workspace/zephyr/soc/infineon/cat3/Kconfig"
osource "/Users/shreybae/Documents/iLAB/nrfedgeAI_workspace/zephyr/soc/infineon/cat1c/Kconfig"
osource "/Users/shreybae/Documents/iLAB/nrfedgeAI_workspace/zephyr/soc/infineon/cat1b/Kconfig"
osource "/Users/shreybae/Documents/iLAB/nrfedgeAI_workspace/zephyr/soc/infineon/cat1a/Kconfig"
osource "/Users/shreybae/Documents/iLAB/nrfedgeAI_workspace/zephyr/soc/gd/gd32/Kconfig"
osource "/Users/shreybae/Documents/iLAB/nrfedgeAI_workspace/zephyr/soc/gaisler/leon3/Kconfig"
osource "/Users/shreybae/Documents/iLAB/nrfedgeAI_workspace/zephyr/soc/gaisler/gr716a/Kconfig"
osource "/Users/shreybae/Documents/iLAB/nrfedgeAI_workspace/zephyr/soc/focaltech/Kconfig"
osource "/Users/shreybae/Documents/iLAB/nrfedgeAI_workspace/zephyr/soc/espressif/Kconfig"
osource "/Users/shreybae/Documents/iLAB/nrfedgeAI_workspace/zephyr/soc/ene/kb1200/Kconfig"
osource "/Users/shreybae/Documents/iLAB/nrfedgeAI_workspace/zephyr/soc/ene/kb106x/Kconfig"
osource "/Users/shreybae/Documents/iLAB/nrfedgeAI_workspace/zephyr/soc/elan/em32f967/Kconfig"
osource "/Users/shreybae/Documents/iLAB/nrfedgeAI_workspace/zephyr/soc/egis/Kconfig"
osource "/Users/shreybae/Documents/iLAB/nrfedgeAI_workspace/zephyr/soc/efinix/sapphire/Kconfig"
osource "/Users/shreybae/Documents/iLAB/nrfedgeAI_workspace/zephyr/soc/cdns/xtensa_sample_controller/Kconfig"
osource "/Users/shreybae/Documents/iLAB/nrfedgeAI_workspace/zephyr/soc/cdns/sample_controller32/Kconfig"
osource "/Users/shreybae/Documents/iLAB/nrfedgeAI_workspace/zephyr/soc/cdns/dc233c/Kconfig"
osource "/Users/shreybae/Documents/iLAB/nrfedgeAI_workspace/zephyr/soc/brcm/bcmvk/Kconfig"
osource "/Users/shreybae/Documents/iLAB/nrfedgeAI_workspace/zephyr/soc/brcm/bcm2712/Kconfig"
osource "/Users/shreybae/Documents/iLAB/nrfedgeAI_workspace/zephyr/soc/brcm/bcm2711/Kconfig"
osource "/Users/shreybae/Documents/iLAB/nrfedgeAI_workspace/zephyr/soc/blackberry/qnxhv_vm/Kconfig"
osource "/Users/shreybae/Documents/iLAB/nrfedgeAI_workspace/zephyr/soc/bflb/Kconfig"
osource "/Users/shreybae/Documents/iLAB/nrfedgeAI_workspace/zephyr/soc/atmel/sam0/Kconfig"
osource "/Users/shreybae/Documents/iLAB/nrfedgeAI_workspace/zephyr/soc/atmel/sam/Kconfig"
osource "/Users/shreybae/Documents/iLAB/nrfedgeAI_workspace/zephyr/soc/aspeed/Kconfig"
osource "/Users/shreybae/Documents/iLAB/nrfedgeAI_workspace/zephyr/soc/arm/Kconfig"
osource "/Users/shreybae/Documents/iLAB/nrfedgeAI_workspace/zephyr/soc/arm/beetle/Kconfig"
osource "/Users/shreybae/Documents/iLAB/nrfedgeAI_workspace/zephyr/soc/antmicro/myra/Kconfig"
osource "/Users/shreybae/Documents/iLAB/nrfedgeAI_workspace/zephyr/soc/andestech/Kconfig"
osource "/Users/shreybae/Documents/iLAB/nrfedgeAI_workspace/zephyr/soc/amd/acp_6_0/Kconfig"
osource "/Users/shreybae/Documents/iLAB/nrfedgeAI_workspace/zephyr/soc/ambiq/Kconfig"
osource "/Users/shreybae/Documents/iLAB/nrfedgeAI_workspace/zephyr/soc/allwinner/sun8i_h3/Kconfig"
osource "/Users/shreybae/Documents/iLAB/nrfedgeAI_workspace/zephyr/soc/aesc/Kconfig"
osource "/Users/shreybae/Documents/iLAB/nrfedgeAI_workspace/zephyr/soc/adi/max32/Kconfig"
osource "/Users/shreybae/Documents/iLAB/nrfedgeAI_workspace/nrf/soc/sercomm/nrf91/Kconfig"
osource "/Users/shreybae/Documents/iLAB/nrfedgeAI_workspace/nrf/soc/nordic/Kconfig"
```

## 05_heyVision_i2s/build/Kconfig/arch/Kconfig
```kconfig
# Load Zephyr Arch Kconfig descriptions.
osource "/Users/shreybae/Documents/iLAB/nrfedgeAI_workspace/zephyr/arch/rx/Kconfig"
osource "/Users/shreybae/Documents/iLAB/nrfedgeAI_workspace/zephyr/arch/x86/Kconfig"
osource "/Users/shreybae/Documents/iLAB/nrfedgeAI_workspace/zephyr/arch/xtensa/Kconfig"
osource "/Users/shreybae/Documents/iLAB/nrfedgeAI_workspace/zephyr/arch/sparc/Kconfig"
osource "/Users/shreybae/Documents/iLAB/nrfedgeAI_workspace/zephyr/arch/riscv/Kconfig"
osource "/Users/shreybae/Documents/iLAB/nrfedgeAI_workspace/zephyr/arch/posix/Kconfig"
osource "/Users/shreybae/Documents/iLAB/nrfedgeAI_workspace/zephyr/arch/mips/Kconfig"
osource "/Users/shreybae/Documents/iLAB/nrfedgeAI_workspace/zephyr/arch/arm64/Kconfig"
osource "/Users/shreybae/Documents/iLAB/nrfedgeAI_workspace/zephyr/arch/arm/Kconfig"
osource "/Users/shreybae/Documents/iLAB/nrfedgeAI_workspace/zephyr/arch/arc/Kconfig"
```

## 07_heyVision_pdm/build/07_heyVision_pdm/Kconfig/boards/Kconfig.tmp
```kconfig
# Load Zephyr board Kconfig descriptions.
osource "/Users/shreybae/Documents/iLAB/nrfedgeAI_workspace/zephyr/boards/nordic/nrf54lm20dk/Kconfig"
```

## 10_beam_wakeword/build/10_beam_wakeword/Kconfig/boards/Kconfig.nrf54lm20dk.tmp
```kconfig
# Load board Kconfig descriptions.
osource "/Users/shreybae/Documents/iLAB/nrfedgeAI_workspace/zephyr/boards/nordic/nrf54lm20dk/Kconfig.nrf54lm20dk"
```
