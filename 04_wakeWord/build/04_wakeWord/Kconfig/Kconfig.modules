## 04_wakeWord/build/04_wakeWord/Kconfig/Kconfig.modules
```kconfig
menu "edge-ai (/Users/shreybae/Documents/iLAB/nrfedgeAI_workspace/edge-ai)"
osource "/Users/shreybae/Documents/iLAB/nrfedgeAI_workspace/edge-ai/zephyr/Kconfig.edge_ai"
config ZEPHYR_EDGE_AI_MODULE
	bool
	default y
endmenu
menu "nrf (/Users/shreybae/Documents/iLAB/nrfedgeAI_workspace/nrf)"
osource "$(ZEPHYR_NRF_KCONFIG)"
config ZEPHYR_NRF_MODULE
	bool
	default y
endmenu
menu "edge-impulse-sdk-zephyr (/Users/shreybae/Documents/iLAB/nrfedgeAI_workspace/modules/edge-impulse-sdk-zephyr)"
osource "/Users/shreybae/Documents/iLAB/nrfedgeAI_workspace/modules/edge-impulse-sdk-zephyr/Kconfig"
config ZEPHYR_EDGE_IMPULSE_SDK_ZEPHYR_MODULE
	bool
	default y
endmenu
menu "mcuboot (/Users/shreybae/Documents/iLAB/nrfedgeAI_workspace/bootloader/mcuboot)"
osource "$(ZEPHYR_MCUBOOT_KCONFIG)"
config ZEPHYR_MCUBOOT_MODULE
	bool
	default y
endmenu
menu "mbedtls (/Users/shreybae/Documents/iLAB/nrfedgeAI_workspace/modules/crypto/mbedtls)"
osource "$(ZEPHYR_MBEDTLS_KCONFIG)"
config ZEPHYR_MBEDTLS_MODULE
	bool
	default y
endmenu
menu "oberon-psa-crypto (/Users/shreybae/Documents/iLAB/nrfedgeAI_workspace/modules/crypto/oberon-psa-crypto)"
osource "/Users/shreybae/Documents/iLAB/nrfedgeAI_workspace/modules/crypto/oberon-psa-crypto/Kconfig.oberon_psa_crypto"
config ZEPHYR_OBERON_PSA_CRYPTO_MODULE
	bool
	default y
endmenu
menu "trusted-firmware-m (/Users/shreybae/Documents/iLAB/nrfedgeAI_workspace/modules/tee/tf-m/trusted-firmware-m)"
osource "$(ZEPHYR_TRUSTED_FIRMWARE_M_KCONFIG)"
config ZEPHYR_TRUSTED_FIRMWARE_M_MODULE
	bool
	default y
endmenu
menu "cjson (/Users/shreybae/Documents/iLAB/nrfedgeAI_workspace/modules/lib/cjson)"
osource "$(ZEPHYR_CJSON_KCONFIG)"
config ZEPHYR_CJSON_MODULE
	bool
	default y
endmenu
menu "azure-sdk-for-c (/Users/shreybae/Documents/iLAB/nrfedgeAI_workspace/modules/lib/azure-sdk-for-c)"
osource "$(ZEPHYR_AZURE_SDK_FOR_C_KCONFIG)"
config ZEPHYR_AZURE_SDK_FOR_C_MODULE
	bool
	default y
endmenu
menu "cirrus-logic (/Users/shreybae/Documents/iLAB/nrfedgeAI_workspace/modules/hal/cirrus-logic)"
osource "/Users/shreybae/Documents/iLAB/nrfedgeAI_workspace/modules/hal/cirrus-logic/Kconfig"
config ZEPHYR_CIRRUS_LOGIC_MODULE
	bool
	default y
endmenu
menu "openthread (/Users/shreybae/Documents/iLAB/nrfedgeAI_workspace/modules/lib/openthread)"
osource "$(ZEPHYR_OPENTHREAD_KCONFIG)"
config ZEPHYR_OPENTHREAD_MODULE
	bool
	default y
endmenu
menu "memfault-firmware-sdk (/Users/shreybae/Documents/iLAB/nrfedgeAI_workspace/modules/lib/memfault-firmware-sdk)"
osource "/Users/shreybae/Documents/iLAB/nrfedgeAI_workspace/modules/lib/memfault-firmware-sdk/ports/zephyr/Kconfig"
config ZEPHYR_MEMFAULT_FIRMWARE_SDK_MODULE
	bool
	default y
endmenu
menu "coremark (/Users/shreybae/Documents/iLAB/nrfedgeAI_workspace/modules/benchmark/coremark)"
osource "$(ZEPHYR_COREMARK_KCONFIG)"
config ZEPHYR_COREMARK_MODULE
	bool
	default y
endmenu
menu "canopennode (/Users/shreybae/Documents/iLAB/nrfedgeAI_workspace/modules/lib/canopennode)"
osource "$(ZEPHYR_CANOPENNODE_KCONFIG)"
config ZEPHYR_CANOPENNODE_MODULE
	bool
	default y
endmenu
menu "chre (/Users/shreybae/Documents/iLAB/nrfedgeAI_workspace/modules/lib/chre)"
osource "/Users/shreybae/Documents/iLAB/nrfedgeAI_workspace/modules/lib/chre/platform/zephyr/Kconfig"
config ZEPHYR_CHRE_MODULE
	bool
	default y
endmenu
menu "cmsis (/Users/shreybae/Documents/iLAB/nrfedgeAI_workspace/modules/hal/cmsis)"
osource "$(ZEPHYR_CMSIS_KCONFIG)"
config ZEPHYR_CMSIS_MODULE
	bool
	default y
endmenu
menu "cmsis-dsp (/Users/shreybae/Documents/iLAB/nrfedgeAI_workspace/modules/lib/cmsis-dsp)"
osource "$(ZEPHYR_CMSIS_DSP_KCONFIG)"
config ZEPHYR_CMSIS_DSP_MODULE
	bool
	default y
endmenu
menu "cmsis-nn (/Users/shreybae/Documents/iLAB/nrfedgeAI_workspace/modules/lib/cmsis-nn)"
osource "$(ZEPHYR_CMSIS_NN_KCONFIG)"
config ZEPHYR_CMSIS_NN_MODULE
	bool
	default y
endmenu
menu "cmsis_6 (/Users/shreybae/Documents/iLAB/nrfedgeAI_workspace/modules/hal/cmsis_6)"
osource "$(ZEPHYR_CMSIS_6_KCONFIG)"
config ZEPHYR_CMSIS_6_MODULE
	bool
	default y
endmenu
menu "fatfs (/Users/shreybae/Documents/iLAB/nrfedgeAI_workspace/modules/fs/fatfs)"
osource "$(ZEPHYR_FATFS_KCONFIG)"
config ZEPHYR_FATFS_MODULE
	bool
	default y
endmenu
menu "hal_nordic (/Users/shreybae/Documents/iLAB/nrfedgeAI_workspace/modules/hal/nordic)"
osource "$(ZEPHYR_HAL_NORDIC_KCONFIG)"
config ZEPHYR_HAL_NORDIC_MODULE
	bool
	default y

config ZEPHYR_HAL_NORDIC_MODULE_BLOBS
	bool
endmenu
menu "hal_st (/Users/shreybae/Documents/iLAB/nrfedgeAI_workspace/modules/hal/st)"
osource "$(ZEPHYR_HAL_ST_KCONFIG)"
config ZEPHYR_HAL_ST_MODULE
	bool
	default y
endmenu
menu "hal_tdk (/Users/shreybae/Documents/iLAB/nrfedgeAI_workspace/modules/hal/tdk)"
osource "$(ZEPHYR_HAL_TDK_KCONFIG)"
config ZEPHYR_HAL_TDK_MODULE
	bool
	default y
endmenu
config ZEPHYR_HAL_WURTHELEKTRONIK_MODULE
	bool
	default y
menu "hostap (/Users/shreybae/Documents/iLAB/nrfedgeAI_workspace/modules/lib/hostap)"
osource "$(ZEPHYR_HOSTAP_KCONFIG)"
config ZEPHYR_HOSTAP_MODULE
	bool
	default y
endmenu
menu "liblc3 (/Users/shreybae/Documents/iLAB/nrfedgeAI_workspace/modules/lib/liblc3)"
osource "$(ZEPHYR_LIBLC3_KCONFIG)"
config ZEPHYR_LIBLC3_MODULE
	bool
	default y
endmenu
config ZEPHYR_LIBMETAL_MODULE
	bool
	default y
menu "libsbc (/Users/shreybae/Documents/iLAB/nrfedgeAI_workspace/modules/lib/libsbc)"
osource "$(ZEPHYR_LIBSBC_KCONFIG)"
config ZEPHYR_LIBSBC_MODULE
	bool
	default y
endmenu
menu "littlefs (/Users/shreybae/Documents/iLAB/nrfedgeAI_workspace/modules/fs/littlefs)"
osource "$(ZEPHYR_LITTLEFS_KCONFIG)"
config ZEPHYR_LITTLEFS_MODULE
	bool
	default y
endmenu
menu "loramac-node (/Users/shreybae/Documents/iLAB/nrfedgeAI_workspace/modules/lib/loramac-node)"
osource "$(ZEPHYR_LORAMAC_NODE_KCONFIG)"
config ZEPHYR_LORAMAC_NODE_MODULE
	bool
	default y
endmenu
menu "lvgl (/Users/shreybae/Documents/iLAB/nrfedgeAI_workspace/modules/lib/gui/lvgl)"
osource "/Users/shreybae/Documents/iLAB/nrfedgeAI_workspace/modules/lib/gui/lvgl/zephyr/Kconfig"
config ZEPHYR_LVGL_MODULE
	bool
	default y
endmenu
config ZEPHYR_MIPI_SYS_T_MODULE
	bool
	default y
menu "nanopb (/Users/shreybae/Documents/iLAB/nrfedgeAI_workspace/modules/lib/nanopb)"
osource "$(ZEPHYR_NANOPB_KCONFIG)"
config ZEPHYR_NANOPB_MODULE
	bool
	default y
endmenu
menu "nrf_wifi (/Users/shreybae/Documents/iLAB/nrfedgeAI_workspace/modules/lib/nrf_wifi)"
osource "$(ZEPHYR_NRF_WIFI_KCONFIG)"
config ZEPHYR_NRF_WIFI_MODULE
	bool
	default y

config ZEPHYR_NRF_WIFI_MODULE_BLOBS
	bool
endmenu
config ZEPHYR_OPEN_AMP_MODULE
	bool
	default y
menu "percepio (/Users/shreybae/Documents/iLAB/nrfedgeAI_workspace/modules/debug/percepio)"
osource "/Users/shreybae/Documents/iLAB/nrfedgeAI_workspace/modules/debug/percepio/zephyr/Kconfig"
config ZEPHYR_PERCEPIO_MODULE
	bool
	default y
endmenu
menu "picolibc (/Users/shreybae/Documents/iLAB/nrfedgeAI_workspace/modules/lib/picolibc)"
osource "/Users/shreybae/Documents/iLAB/nrfedgeAI_workspace/modules/lib/picolibc/zephyr/Kconfig"
config ZEPHYR_PICOLIBC_MODULE
	bool
	default y
endmenu
menu "segger (/Users/shreybae/Documents/iLAB/nrfedgeAI_workspace/modules/debug/segger)"
osource "$(ZEPHYR_SEGGER_KCONFIG)"
config ZEPHYR_SEGGER_MODULE
	bool
	default y
endmenu
config ZEPHYR_TF_M_TESTS_MODULE
	bool
	default y
menu "uoscore-uedhoc (/Users/shreybae/Documents/iLAB/nrfedgeAI_workspace/modules/lib/uoscore-uedhoc)"
osource "$(ZEPHYR_UOSCORE_UEDHOC_KCONFIG)"
config ZEPHYR_UOSCORE_UEDHOC_MODULE
	bool
	default y
endmenu
menu "zcbor (/Users/shreybae/Documents/iLAB/nrfedgeAI_workspace/modules/lib/zcbor)"
osource "$(ZEPHYR_ZCBOR_KCONFIG)"
config ZEPHYR_ZCBOR_MODULE
	bool
	default y
endmenu
menu "nrfxlib (/Users/shreybae/Documents/iLAB/nrfedgeAI_workspace/nrfxlib)"
osource "/Users/shreybae/Documents/iLAB/nrfedgeAI_workspace/nrfxlib/Kconfig.nrfxlib"
config ZEPHYR_NRFXLIB_MODULE
	bool
	default y
endmenu
config ZEPHYR_NRF_HW_MODELS_MODULE
	bool
	default y
menu "connectedhomeip (/Users/shreybae/Documents/iLAB/nrfedgeAI_workspace/modules/lib/matter)"
osource "/Users/shreybae/Documents/iLAB/nrfedgeAI_workspace/modules/lib/matter/config/nrfconnect/chip-module/Kconfig"
config ZEPHYR_CONNECTEDHOMEIP_MODULE
	bool
	default y
endmenu
```

## 04_wakeWord/build/04_wakeWord/Kconfig/Kconfig.shield.defconfig
```kconfig
osource "/Users/shreybae/Documents/iLAB/nrfedgeAI_workspace/nrf/boards/shields/*/Kconfig.defconfig"
```

## 04_wakeWord/build/04_wakeWord/Kconfig/boards/Kconfig.defconfig
```kconfig
# Load Zephyr board defconfig descriptions.
osource "/Users/shreybae/Documents/iLAB/nrfedgeAI_workspace/zephyr/boards/nordic/nrf54lm20dk/Kconfig.defconfig"
```
