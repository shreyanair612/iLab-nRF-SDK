## prj.conf
```kconfig
#
# Copyright (c) 2026 Nordic Semiconductor
#
# SPDX-License-Identifier: LicenseRef-Nordic-5-Clause
#

# nRF Edge AI
CONFIG_NRF_EDGEAI=y

# nRF Edge AI dependencies
CONFIG_NRF_AXON=y
CONFIG_NEWLIB_LIBC=y
CONFIG_FPU=y

# Size of interlayer buffer to fit model
CONFIG_NRF_AXON_INTERLAYER_BUFFER_SIZE=6048

# Size of psum buffer to fit model
CONFIG_NRF_AXON_PSUM_BUFFER_SIZE=0

# Peripherals
CONFIG_GPIO=y
CONFIG_I2S=y

# Enable logging and assert
CONFIG_LOG=y
CONFIG_CONSOLE=y
CONFIG_SERIAL=y
CONFIG_ASSERT=y

CONFIG_UART_ASYNC_API=y
CONFIG_MAIN_STACK_SIZE=4096
```

## src/dmic.c
```c
/*
 * Copyright (c) 2026 Nordic Semiconductor ASA
 *
 * SPDX-License-Identifier: LicenseRef-Nordic-5-Clause
 */

#include <zephyr/kernel.h>
#include <zephyr/device.h>
#include <zephyr/drivers/i2s.h>
#include <zephyr/logging/log.h>
#include <string.h>

#include "dmic.h"

LOG_MODULE_REGISTER(dmic);

#define I2S_MIC_RX DT_NODELABEL(tdm)

BUILD_ASSERT(DT_NODE_HAS_STATUS(I2S_MIC_RX, okay),
	     "TDM/I2S is disabled. Check that the board overlay is applied.");

#define I2S_WORD_SIZE_BITS 32
#define I2S_CHANNELS 2
#define I2S_TIMEOUT_MS 2000

#define BLOCK_SIZE (DMIC_PCM_RATE * SAMPLES_BLOCK_LENGTH_MS / 1000 * \
		    I2S_CHANNELS * (I2S_WORD_SIZE_BITS / 8))
#define BLOCK_COUNT 8

K_MEM_SLAB_DEFINE_IN_SECT_STATIC(rx_mem_slab, __nocache, BLOCK_SIZE, BLOCK_COUNT, 4);
K_MEM_SLAB_DEFINE_STATIC(app_mem_slab,
			 (DMIC_PCM_RATE * SAMPLES_BLOCK_LENGTH_MS / 1000) * DMIC_SAMPLE_BYTES,
			 BLOCK_COUNT, 4);

static const struct device *const i2s_dev = DEVICE_DT_GET(I2S_MIC_RX);

static int16_t extract_left_sample(int32_t raw)
{
	return (int16_t)(raw >> 16);
}

int dmic_init(void)
{
	struct i2s_config i2s_cfg = {
		.word_size = I2S_WORD_SIZE_BITS,
		.channels = I2S_CHANNELS,
		.format = I2S_FMT_DATA_FORMAT_I2S,
		.options = I2S_OPT_BIT_CLK_MASTER | I2S_OPT_FRAME_CLK_MASTER,
		.frame_clk_freq = DMIC_PCM_RATE,
		.mem_slab = &rx_mem_slab,
		.block_size = BLOCK_SIZE,
		.timeout = I2S_TIMEOUT_MS,
	};
	int ret;

	if (!device_is_ready(i2s_dev)) {
		LOG_ERR("I2S device is not ready");
		return -ENODEV;
	}

	ret = i2s_configure(i2s_dev, I2S_DIR_RX, &i2s_cfg);
	if (ret < 0) {
		LOG_ERR("i2s_configure failed: %d", ret);
		return ret;
	}

	LOG_INF("INMP441 I2S audio initialized at %d Hz", DMIC_PCM_RATE);
	return 0;
}

int dmic_start(void)
{
	int ret = i2s_trigger(i2s_dev, I2S_DIR_RX, I2S_TRIGGER_START);

	if (ret < 0) {
		LOG_ERR("I2S start failed: %d", ret);
		return ret;
	}

	LOG_INF("INMP441 I2S capture started");
	return 0;
}

int dmic_read(void **buffer, size_t *buffer_size, int32_t timeout_ms)
{
	ARG_UNUSED(timeout_ms);

	void *mem_block;
	size_t raw_block_size = BLOCK_SIZE;
	int ret;

	ret = i2s_read(i2s_dev, &mem_block, &raw_block_size);
	if (ret < 0) {
		LOG_ERR("i2s_read failed: %d", ret);
		return ret;
	}

	void *app_block;
	ret = k_mem_slab_alloc(&app_mem_slab, &app_block, K_NO_WAIT);
	if (ret < 0) {
		LOG_ERR("Failed to allocate app audio buffer: %d", ret);
		k_mem_slab_free(&rx_mem_slab, mem_block);
		return ret;
	}

	int32_t *raw = (int32_t *)mem_block;
	int16_t *pcm = (int16_t *)app_block;
	const size_t samples_per_chunk = DMIC_PCM_RATE * SAMPLES_BLOCK_LENGTH_MS / 1000;

	for (size_t i = 0; i < samples_per_chunk; i++) {
		pcm[i] = extract_left_sample(raw[i * I2S_CHANNELS]);
	}

	k_mem_slab_free(&rx_mem_slab, mem_block);

	*buffer = app_block;
	*buffer_size = samples_per_chunk * DMIC_SAMPLE_BYTES;

	return 0;
}

void free_dmic_buffer(void *buffer)
{
	k_mem_slab_free(&app_mem_slab, buffer);
}
```

## src/wakeword.c
```c
/*
 * Copyright (c) 2026 Nordic Semiconductor ASA
 *
 * SPDX-License-Identifier: LicenseRef-Nordic-5-Clause
 */

#include <stddef.h>
#include <stdint.h>

#include <zephyr/logging/log.h>
#include <nrf_edgeai/nrf_edgeai.h>

#include "dmic.h"
#include "wakeword.h"
#include "nrf_edgeai_generated/nrf_edgeai_user_model.h"

LOG_MODULE_REGISTER(ww);

static nrf_edgeai_t *ww_model;

int ww_init(void)
{
	ww_model = nrf_edgeai_user_model_wakeword();
	__ASSERT_NO_MSG(ww_model);

	nrf_edgeai_err_t err = nrf_edgeai_init(ww_model);

	if (err) {
		LOG_ERR("Model initialization failed (err %d)", err);
		return -ENOENT;
	}

	return 0;
}

static bool ww_postprocess(void)
{
	static uint32_t ww_count;
	static uint32_t ww_history;
	static int64_t last_detect_time_ms;

	const float ww_threshold = CONFIG_WW_PROBABILITY_THRESHOLD / 1000.f;
	const int64_t now_ms = k_uptime_get();
	const int64_t cooldown_ms = 1200;

	const uint16_t predicted_class = ww_model->decoded_output.classif.predicted_class;
	const float class_probability =
		ww_model->decoded_output.classif.probabilities.p_f32[predicted_class];
	const bool ww_detected = class_probability > ww_threshold;

	const bool oldest_entry = (bool)(ww_history & BIT(CONFIG_WW_HISTORY_SIZE - 1));

	ww_count = ww_count + ww_detected - oldest_entry;
	ww_history = (ww_history << 1) | ww_detected;

	LOG_DBG("postprocess: count: %2u, probability: %f", ww_count, (double)class_probability);

	if (ww_count >= CONFIG_WW_COUNT_THRESHOLD) {
		ww_count = 0;
		ww_history = 0;

		if ((now_ms - last_detect_time_ms) < cooldown_ms) {
			return false;
		}

		last_detect_time_ms = now_ms;
		return true;
	}

	return false;
}

int ww_process(uint8_t *const audio_buffer, const uint16_t num_samples, bool *const ww_detected)
{
	__ASSERT_NO_MSG(audio_buffer);
	__ASSERT_NO_MSG(num_samples == nrf_edgeai_input_window_size(ww_model));
	__ASSERT_NO_MSG(ww_detected);

	nrf_edgeai_err_t err;

	err = nrf_edgeai_feed_inputs(ww_model, audio_buffer, num_samples);
	free_dmic_buffer(audio_buffer);

	if (err == NRF_EDGEAI_ERR_INPROGRESS) {
		/* Skip inference, not enough data. */
		return -EBUSY;
	} else if (err) {
		LOG_ERR("Failed to feed inputs (err %d)", err);
		return -EPERM;
	}

	err = nrf_edgeai_run_inference(ww_model);
	if (err == NRF_EDGEAI_ERR_INPROGRESS) {
		/* Skip output extraction, not enough data. */
		return -EBUSY;
	} else if (err) {
		LOG_ERR("Failed to run inference (err %d)", err);
		return -EPERM;
	}

	*ww_detected = ww_postprocess();

	return 0;
}
```
